## main/Kconfig.projbuild
```kconfig
menu "Bitaxe Configuration"

    menu "Bitaxe 1002 Bonanza production safety"
        config BZM_1002_PROOF_TIMEOUT_SECONDS
            int "Mining proof and recovery timeout (seconds)"
            range 1 300
            default 15
            help
                Maximum RUNNING time allowed to prove one complete four-ASIC
                work dispatch and the configured number of locally valid ASIC
                results. After proof, the same bound applies independently to
                each new recoverable result-corruption episode. Initial proof
                or recovery expiry is BAD and forces safe-off.

        config BZM_1002_MIN_VALID_RESULTS
            int "Minimum locally valid mining results"
            range 1 100
            default 1
            help
                Number of current-work ASIC results that must map to the
                active generation and pass local nonce/work validation.

        config BZM_1002_MAX_LOCAL_REJECTIONS
            int "Maximum consecutive locally rejected results"
            range 0 100
            default 1
            help
                Maximum consecutive current-work ASIC results that may fail
                local nonce/work validation. A later locally valid nonce
                resets the streak and proves recovery; the lifetime total
                remains visible. Exceeding this streak is BAD and forces
                safe-off. Non-nonce status frames are not results.

        config BZM_1002_MAX_MAPPING_REJECTIONS
            int "Maximum consecutive result-attribution rejections"
            range 1 100
            default 2
            help
                Maximum consecutive unattributable nonce-like frames when
                mapping recovery is enabled. A later locally valid nonce
                resets the streak while the lifetime total remains visible.
                Exceeding this streak, or failing to recover before the proof
                timeout, is BAD and forces safe-off.

        config BZM_1002_MIN_NONCE_DIFFICULTY
            int "Minimum locally verified nonce difficulty"
            range 1 1024
            default 1
            help
                Minimum locally calculated difficulty for each result counted
                as mining-health evidence. A mapped result below this floor is a
                local validation rejection, because the ASIC result filter is
                configured to suppress it before transmission.

        config BZM_1002_LEAD_ZEROS
            int "ASIC result-filter leading-zero bits"
            range 32 64
            default 36
            help
                Program every Bonanza engine to report only hashes with at
                least this many leading zero bits. The 36-bit default reduces
                result UART traffic by four times relative to the historical
                34-bit setting while retaining an expected proof difficulty
                near 16. Raising this value reduces traffic and proof rate;
                lowering it increases both. Parser loss remains BAD.

        config BZM_1002_DISPATCH_GAP_US
            int "Inter-engine bridge drain gap (microseconds)"
            range 0 2000
            default 250
            help
                After each logical engine has been programmed on all four
                ASICs, wait for ESP UART TX completion, leave this bounded
                idle interval on the 5 Mbaud link, and drain received TDM
                traffic. Zero disables the idle interval but retains the TX
                completion and RX-drain checkpoint. Any checkpoint failure or
                parser corruption outside the separately configured bounded
                realignment policy remains BAD and forces safe-off.

        config BZM_1002_PARSER_REALIGN_MAX_DISCARDS
            int "Maximum discarded bytes per parser realignment"
            range 1 256
            default 32
            help
                Maximum discarded bytes in one recoverable RUNNING burst.
                Exceeding this bound is continuous corruption and is BAD.

        config BZM_1002_PARSER_REALIGN_CLEAN_WINDOWS
            int "Clean health windows required after parser realignment"
            range 1 10
            default 2
            help
                Consecutive 500 ms runtime-health windows with no new discard
                and no partial buffered frame after a valid post-discard frame
                before recovery is accepted. Complete results already waiting
                in the consumer queue do not prevent parser realignment.

        config BZM_1002_PARSER_REALIGN_MAX_WINDOWS
            int "Maximum parser realignment windows"
            range 2 20
            default 6
            help
                Maximum 500 ms runtime-health observations allowed for one
                realignment. Failure to settle by then is BAD.

        config BZM_1002_PARSER_REALIGN_MAX_EVENTS
            int "Maximum discard bursts per parser realignment"
            range 1 20
            default 2
            help
                Maximum observations with new discarded bytes during one
                unresolved realignment episode. A successfully realigned
                parser resets this count; exceeding it before recovery is
                continuous corruption and is BAD.

        config BZM_1002_FAN_MIN_RPM
            int "Provisional minimum fan RPM"
            range 1 30000
            default 1000
            help
                Minimum fresh fan tach reading before and during mining. This is
                provisional until the production fan is characterized.

        config BZM_1002_SAFE_OFF_VCORE_MV
            int "Safe-off VCORE discharge threshold (mV)"
            range 0 1000
            default 250
            help
                Maximum fresh TPS READ_VOUT that may be reported as a GOOD
                safe-off result. This threshold must be qualified against
                the production board discharge network before enabling
                powered operation.

        config BZM_1002_TELEMETRY_MAX_AGE_MS
            int "Maximum Bonanza ASIC telemetry age (milliseconds)"
            range 100 5000
            default 1000
            help
                Sensor, clock and runtime checks reject older samples. Every
                startup step requires evidence captured after its writes.

        config BZM_1002_SENSOR_TDM_GAP_COUNT
            int "Thermal/voltage TDM reporting interval gap"
            range 0 63
            default 0
            help
                Programs Bonanza local register 0x2d. Zero is the BIRDS
                maximum-rate reference; larger values skip reporting
                intervals and reduce shared TDM traffic. At the reference
                5 Mbaud, 100-slot, 127-bit schedule, 63 is approximately
                6.2 reports per second per ASIC and remains inside the
                default one-second telemetry freshness requirement.

        config BZM_1002_TEMP_MIN_C
            int "Provisional minimum ASIC temperature (C)"
            range -100 100
            default -20

        config BZM_1002_TEMP_MAX_C
            int "Provisional maximum ASIC temperature (C)"
            range 1 150
            default 105
            help
                Fresh on-die telemetry at or above this engineering ceiling
                is BAD. Qualify this value on production hardware.

        config BZM_1002_STACK_MV_MIN
            int "Provisional minimum internal stack voltage (mV)"
            range 0 2000
            default 300

        config BZM_1002_STACK_MV_MAX
            int "Provisional maximum internal stack voltage (mV)"
            range 1 2000
            default 800
            help
                Applied independently to CH0 (bottom stack) and CH1 (top
                stack). The conversion and limits must be calibrated from
                device captures before production enablement.

        config BZM_1002_INTERSTACK_DIFF_ABS_MAX_MV
            int "Maximum absolute CH2 inter-stack differential (mV)"
            range 1 200
            default 50
            help
                CH2 measures the differential between top-stack VSS and
                bottom-stack VDD; it is not a third stack voltage. Runtime
                monitoring requires its absolute value to remain at or below this
                provisional engineering limit.

        config BZM_1002_CH2_CONFIRM_SAMPLES
            int "Consecutive CH2 excursions required for shutdown"
            range 1 10
            default 3
            help
                Number of consecutive fresh per-ASIC telemetry frames that
                must exceed the CH2 absolute differential limit before the
                excursion is treated as continuous. A recovered frame resets
                that ASIC's count. Set to 1 for immediate shutdown. This
                confirmation applies only to finite CH2 excursions; trips,
                sensor faults, invalid/stale/missing telemetry, CH0/CH1 or
                temperature violations and stack imbalance remain immediate
                failures. Live combined PLL lock telemetry is handled by its
                separate confirmation setting.

        config BZM_1002_PLL_LOCK_CONFIRM_SAMPLES
            int "Consecutive combined PLL-lock clears required for shutdown"
            range 1 10
            default 1
            help
                Number of consecutive fresh per-ASIC telemetry frames whose
                unchecksummed combined PLL0/PLL1 lock bit must be clear before
                runtime shutdown. A fresh locked frame resets that ASIC's
                count. Set to 1 for immediate shutdown. This does not weaken
                the initial PLL register readback and direct lock
                validation. Trips, voltage-command changes, and all unrelated
                safety faults remain immediate failures.

        config BZM_1002_STACK_MAX_SPREAD_MV
            int "Provisional maximum CH0/CH1 stack spread (mV)"
            range 1 1000
            default 100
            help
                Maximum absolute difference between CH0 (bottom stack) and
                CH1 (top stack) on one ASIC. CH2 has its own inter-stack
                differential limit and is not included in this spread. A
                larger CH0/CH1 spread is treated as a stack-imbalance fault.
                This provisional threshold must be calibrated from production
                device captures.

    endmenu

    menu "GPIO Pin Configuration"

        config GPIO_BUTTON_BOOT
            int "Boot button GPIO pin"
            default 0
            help
                GPIO pin connected to the BOOT button.

        config GPIO_ASIC_RESET
            int "ASIC reset GPIO pin"
            default 1
            help
                GPIO pin for ASIC_RESET (RST_N), reset input to ASIC.

        config GPIO_ASIC_ENABLE
            int "ASIC enable GPIO pin"
            default 10
            help
                GPIO pin for ASIC_ENABLE (POWER_EN), enable for core power supply.

        config GPIO_PLUG_SENSE
            int "Barrel plug sense GPIO pin"
            default 12
            help
                GPIO pin for DC barrel (PLUG_SENSE), sense pin of DC power jack socket.

        config GPIO_I2C_SDA
            int "I2C SDA Pin"
            default 47
            help
                GPIO pin for I2C clock line (SDA).
            
        config GPIO_I2C_SCL
            int "I2C SCL Pin"
            default 48
            help
                GPIO pin for I2C clock line (SCL).
        config GPIO_BAP_RX
            int "I2C BAP Pin"
            default 40
            help
                GPIO pin for BAP receiving line.
        config GPIO_BAP_TX
            int "I2C BAP Pin"
            default 39
            help
                GPIO pin for BAP transmitting line.
            
    endmenu
    
    config ASIC_VOLTAGE
        int "ASIC Core Voltage (mV)"
        range 1000 1800
        default 1400
        help
            The core voltage to set the ASIC to. 1200 for BM1366 or 1400 for BM1397 is typical.

    config ASIC_FREQUENCY
        int "ASIC Hash Frequency (MHz)"
        range 50 800
        default 250
        help
            The BM1397 hash frequency
endmenu

menu "Stratum Configuration"

    config STRATUM_URL
        string "Stratum Address"
        default "public-pool.io"
        help
            The example will connect to this Stratum pool address.

    config STRATUM_PORT
        int "Stratum Port"
        range 0 65535
        default 21496
        help
            The stratum server port to connect to.
    
    choice
        prompt "Stratum TLS mode"
        default STRATUM_TLS_DISABLED
        help
            Select how TLS is used for stratum connections.

        config STRATUM_TLS_DISABLED
            bool "Disabled"

        config STRATUM_TLS_BUNDLED
            bool "Enabled (bundled CA certificate)"

        config STRATUM_TLS_CUSTOM
            bool "Enabled (user-provided/custom CA certificate)"
    endchoice

    config STRATUM_TLS
        int
        default 0 if STRATUM_TLS_DISABLED
        default 1 if STRATUM_TLS_BUNDLED
        default 2 if STRATUM_TLS_CUSTOM
    
    config STRATUM_CERT
        string "Stratum Certificate"
        default "x"
        help
            The certificate to use with the stratum connection.

    config EXTRANONCE_SUBSCRIBE
        bool "Pool extranonce subscribe"
        default n
        help
            Enable stratum extranonce subscribe.

    config FALLBACK_STRATUM_URL
        string "Fallback Stratum Address"
        default "solo.ckpool.org"
        help
            The example will connect to this Stratum pool address if the primary fails.

    config FALLBACK_STRATUM_PORT
        int "Fallback Stratum Port"
        range 0 65535
        default 3333
        help
            The stratum server port to connect to if the primary fails.
    
    choice
        prompt "Fallback Stratum TLS mode"
        default FALLBACK_STRATUM_TLS_DISABLED
        help
            Select how TLS is used for stratum connections.

        config FALLBACK_STRATUM_TLS_DISABLED
            bool "Disabled"

        config FALLBACK_STRATUM_TLS_BUNDLED
            bool "Enabled (bundled CA certificate)"

        config FALLBACK_STRATUM_TLS_CUSTOM
            bool "Enabled (user-provided/custom CA certificate)"
    endchoice

    config FALLBACK_STRATUM_TLS
        int
        default 0 if FALLBACK_STRATUM_TLS_DISABLED
        default 1 if FALLBACK_STRATUM_TLS_BUNDLED
        default 2 if FALLBACK_STRATUM_TLS_CUSTOM
    
    config FALLBACK_STRATUM_CERT
        string "Fallback Stratum Certificate"
        default "x"
        help
            The certificate to use with the stratum connection if the primary fails.

    config FALLBACK_EXTRANONCE_SUBSCRIBE
        bool "Fallback pool extranonce subscribe"
        default n
        help
            Enable fallback pool extranonce subscribe.

    config STRATUM_USER
        string "Stratum username"
        default "replace-this-with-your-btc-address.bitaxe"
        help
            Stratum user to use with pool

    config STRATUM_PW
        string "Stratum password"
        default "x"
        help
            Stratum password to use with pool

    config FALLBACK_STRATUM_USER
        string "Fallback Stratum username"
        default "replace-this-with-your-btc-address.bitaxe"
        help
            Fallback Stratum user to use with pool

    config FALLBACK_STRATUM_PW
        string "Fallback Stratum password"
        default "x"
        help
            Fallback Stratum password to use with pool

    config STRATUM_DIFFICULTY
        int "Stratum default difficulty"
        range 0 4294967296
        default 1000
        help
            A starting difficulty to use with the pool.

    config FALLBACK_STRATUM_DIFFICULTY
        int "Fallback stratum default difficulty"
        range 0 4294967296
        default 1000
        help
            A starting difficulty to use with the fallback pool.

    config ENABLE_TASK_MONITOR
        bool "Task Monitor"
        default n
        help
            Enable task monitor. NOTE: This is intended for debugging use only as the use of uxTaskGetSystemState results in the scheduler remaining suspended for an extended period.

endmenu
```
